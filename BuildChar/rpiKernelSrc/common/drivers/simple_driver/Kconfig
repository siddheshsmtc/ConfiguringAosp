## BuildChar/rpiKernelSrc/common/drivers/simple_driver/Kconfig
```kconfig
config SIMPLE_DRIVER_MOD
	tristate "CHAR Module"
	default m
	depends on MODULES
	help
	  This module acts as a basic char driver 
```
